## config/boards/shields/waka/Kconfig.defconfig
```kconfig
if SHIELD_WAKA

config ZMK_KEYBOARD_NAME
	default "Waka"

config ZMK_RGB_UNDERGLOW
    depends on ZMK_BOARD_PILLBUG

config ZMK_SLEEP
    depends on ZMK_BOARD_PILLBUG

endif
```

## config/boards/shields/waka/boards/pillbug.conf
```kconfig
# RGB LEDs enabled by default, so end-users can more easily distinguish soldering problems from config problems
CONFIG_ZMK_RGB_UNDERGLOW=y
CONFIG_WS2812_STRIP=y
```

## config/west.yml
```yaml
manifest:
  remotes:
    - name: zmkfirmware
      url-base: https://github.com/zmkfirmware
    - name: mechwild
      url-base: https://github.com/lesshonor
  projects:
    - name: zmk
      remote: zmkfirmware
      revision: main
      import: app/west.yml
    - name: mechwild-zmk-keyboards
      remote: mechwild
      revision: main
  self:
    path: config
```
